## CMakeLists.txt
```
# SPDX-License-Identifier: Apache-2.0
cmake_minimum_required(VERSION 3.20.0)
find_package(Zephyr REQUIRED HINTS $ENV{ZEPHYR_BASE})
project(keycap_firmware)

target_sources(app PRIVATE
  src/main.c
  src/gesture.c
  src/lighting.c
  src/line_reader.c
  src/audio.c
  src/audio_bands.c
  src/neokey.c
  src/protocol.c
)
```

## prj.conf
```kconfig
# SPDX-License-Identifier: Apache-2.0
CONFIG_I2C=y
CONFIG_SERIAL=y
CONFIG_CONSOLE=y
CONFIG_UART_CONSOLE=y
CONFIG_UART_INTERRUPT_DRIVEN=y
CONFIG_LOG=n
CONFIG_MAIN_STACK_SIZE=2048
CONFIG_ASSERT=y

# Audio-reactive lighting: the on-board PDM microphone.
# Samples are analysed on the device and never reach the host; the link could
# not carry them anyway, at 32 kB/s of PCM against a 11.5 kB/s serial budget.
CONFIG_AUDIO=y
CONFIG_AUDIO_DMIC=y
CONFIG_REGULATOR=y
CONFIG_REGULATOR_FIXED=y
```

## boards/xiao_nrf54l15_nrf54l15_cpuapp.overlay
```dts
/* SPDX-License-Identifier: Apache-2.0 */
#include <zephyr/dt-bindings/i2c/i2c.h>

/ {
	aliases {
		neokey-i2c = &xiao_i2c;
	};
};

&xiao_i2c {
	status = "okay";
	/* Fast mode quarters the ~2 ms the main loop spends blocking on each LED
	 * frame, which buys headroom for the audio visualiser and reduces the
	 * pressure that overflows the serial receive ring.
	 */
	clock-frequency = <I2C_BITRATE_FAST>;
};
```

## src/main.c
```c
/* SPDX-License-Identifier: Apache-2.0 */
#include "neokey.h"
#include "protocol.h"
#include "gesture.h"
#include "lighting.h"
#include "line_reader.h"
#include "audio.h"

#include <errno.h>
#include <string.h>
#include <zephyr/device.h>
#include <zephyr/devicetree.h>
#include <zephyr/drivers/uart.h>
#include <zephyr/irq.h>
#include <zephyr/kernel.h>
#include <zephyr/sys/ring_buffer.h>

#define NEOKEY_ADDRESS 0x30
#define DEBOUNCE_SAMPLES 2
#define HOST_WATCHDOG_MS 5000u
#define HOST_HELLO_RETRY_MS 2000u
#define NEOKEY_RETRY_SLICE_MS 50u
#define NEOKEY_RETRY_SLICES 20u

static const struct device *const console = DEVICE_DT_GET(DT_CHOSEN(zephyr_console));
static const struct device *const i2c = DEVICE_DT_GET(DT_ALIAS(neokey_i2c));
RING_BUF_DECLARE(serial_rx, 512);

/* Set from the receive interrupt when the ring cannot hold an incoming chunk.
 * The dropped bytes may include a newline, so the main loop must discard the
 * damaged region rather than parse two spliced commands as one.
 */
static volatile bool serial_rx_overflow;
static struct keycap_line_reader line_reader;

/* Set once the microphone has been powered down for want of anything to
 * listen to. Cleared by a key press or by the host changing the lighting.
 */
static bool audio_asleep;

/* Kept visible for probe-based bring-up and field diagnostics.
 *
 * When the console does not come up there is no way to report a fault, so
 * bring-up state is recorded in RAM where a debugger can read it:
 *
 *   arm-zephyr-eabi-nm build/zephyr/zephyr.elf | grep keycap_
 *   openocd ... -c "halt" -c "mdw <address> 1" -c "resume"
 *
 * keycap_console_ready  1 once the console device reports ready
 * keycap_serial_error   0 once the receive callback is installed
 * keycap_neokey_status  0 once the NeoKey answers on I2C
 */
volatile int keycap_neokey_status = -EINPROGRESS;
volatile int keycap_console_ready = -1;
volatile int keycap_serial_error = -EINPROGRESS;

static void serial_rx_callback(const struct device *device, void *user_data)
{
	ARG_UNUSED(user_data);
	uint8_t bytes[32];

	uart_irq_update(device);
	if (!uart_irq_rx_ready(device)) {
		return;
	}

	int count;
	while ((count = uart_fifo_read(device, bytes, sizeof(bytes))) > 0) {
		if (ring_buf_put(&serial_rx, bytes, (uint32_t)count) <
		    (uint32_t)count) {
			serial_rx_overflow = true;
		}
	}
}

static bool take_rx_overflow(void)
{
	unsigned int key = irq_lock();
	bool overflowed = serial_rx_overflow;

	serial_rx_overflow = false;
	irq_unlock(key);
	return overflowed;
}

static int serial_rx_start(void)
{
	keycap_console_ready = device_is_ready(console) ? 1 : 0;
	if (keycap_console_ready != 1) {
		return -ENODEV;
	}

	int error = uart_irq_callback_user_data_set(console, serial_rx_callback, NULL);
	keycap_serial_error = error;
	if (error != 0) {
		return error;
	}
	uart_irq_rx_enable(console);
	return 0;
}

static void serial_write(const char *text)
{
	while (*text != '\0') {
		uart_poll_out(console, *text++);
	}
}

static void send_hello(void)
{
	serial_write("HELLO 3 keycap-fw xiao-nrf54l15-sense\n");
}

static int show_status(struct neokey *keys, enum keycap_status status,
		       uint8_t active_choices, const struct keycap_rgb *accent)
{
	struct keycap_rgb colors[KEYCAP_LED_COUNT] = {0};
	struct keycap_rgb color = {0};
	uint8_t count = KEYCAP_LED_COUNT;

	switch (status) {
	case KEYCAP_STATUS_IDLE:
		color = (struct keycap_rgb){.red = 0, .green = 12, .blue = 28};
		break;
	case KEYCAP_STATUS_WAITING:
		color = accent != NULL ? *accent :
			(struct keycap_rgb){.red = 90, .green = 120, .blue = 255};
		count = active_choices;
		break;
	case KEYCAP_STATUS_SUCCESS:
		color = (struct keycap_rgb){.red = 0, .green = 255, .blue = 40};
		break;
	case KEYCAP_STATUS_ERROR:
		color = (struct keycap_rgb){.red = 255, .green = 0, .blue = 0};
		break;
	case KEYCAP_STATUS_PAUSED:
		color = (struct keycap_rgb){.red = 255, .green = 80, .blue = 0};
		break;
	}

	for (uint8_t index = 0; index < count && index < KEYCAP_LED_COUNT; ++index) {
		colors[index] = color;
	}
	return neokey_set_leds(keys, colors);
}

static bool process_line(struct neokey *keys, bool keys_ready,
			 struct keycap_lighting_profile *lighting,
			 enum keycap_agent_state agents[KEYCAP_LED_COUNT],
			 bool *agents_active, bool *status_active, char *line)
{
	struct keycap_command command;
	if (!keycap_protocol_parse(line, &command)) {
		serial_write("ERROR bad-command ");
		serial_write(line);
		serial_write("\n");
		return false;
	}

	if (command.type == KEYCAP_COMMAND_PING) {
		send_hello();
		return true;
	}
	if (command.type == KEYCAP_COMMAND_KEEPALIVE) {
		/* The acknowledgement lets the host detect a stale macOS serial
		 * descriptor after the board has been unplugged and reconnected.
		 */
		serial_write("ALIVE\n");
		return true;
	}
	if (!keys_ready) {
		/* The NeoKey is not addressable yet. Keep the framing healthy and
		 * stay silent; the host resends state after the next HELLO.
		 */
		return true;
	}

	if (command.type == KEYCAP_COMMAND_LEDS) {
		if (neokey_set_leds(keys, command.leds) != 0) {
			serial_write("ERROR i2c-write\n");
		}
	} else if (command.type == KEYCAP_COMMAND_STATUS) {
		if (show_status(keys, command.status, command.active_choices,
				command.has_status_color ? &command.status_color
							 : NULL) != 0) {
			serial_write("ERROR i2c-write\n");
		} else {
			*agents_active = false;
			*status_active = command.status != KEYCAP_STATUS_IDLE;
		}
	} else if (command.type == KEYCAP_COMMAND_LIGHTING) {
		*lighting = command.lighting;
		/* Choosing an effect is an explicit request to listen again. */
		audio_asleep = false;
	} else if (command.type == KEYCAP_COMMAND_AGENTS) {
		memcpy(agents, command.agents, sizeof(command.agents));
		*agents_active = true;
		*status_active = false;
	}
	return true;
}

static void pump_serial(struct neokey *keys, bool keys_ready,
			struct keycap_lighting_profile *lighting,
			enum keycap_agent_state agents[KEYCAP_LED_COUNT],
			bool *agents_active, bool *status_active,
			uint32_t *last_host_command, bool *host_timed_out)
{
	uint8_t byte;

	if (take_rx_overflow()) {
		keycap_line_reader_resynchronize(&line_reader);
		serial_write("ERROR rx-overflow\n");
	}

	while (ring_buf_get(&serial_rx, &byte, 1) == 1) {
		switch (keycap_line_reader_push(&line_reader, byte)) {
		case KEYCAP_LINE_READY:
			if (process_line(keys, keys_ready, lighting, agents,
					 agents_active, status_active,
					 line_reader.line)) {
				*last_host_command = k_uptime_get_32();
				*host_timed_out = false;
			}
			break;
		case KEYCAP_LINE_OVERFLOW:
			serial_write("ERROR line-too-long\n");
			break;
		case KEYCAP_LINE_NONE:
			break;
		}
	}
}

int main(void)
{
	struct neokey keys;
	char event_line[48];
	uint8_t stable = 0;
	uint8_t candidate = 0;
	uint8_t candidate_count = 0;
	uint32_t sequence = 0;
	uint32_t last_host_command = k_uptime_get_32();
	uint32_t last_hello_retry = k_uptime_get_32();
	bool host_timed_out = false;
	uint32_t last_lighting_frame = UINT32_MAX;
	struct keycap_gesture_detector gestures;
	struct keycap_lighting_profile lighting;
	enum keycap_agent_state agent_states[KEYCAP_LED_COUNT] = {
		KEYCAP_AGENT_EMPTY, KEYCAP_AGENT_EMPTY, KEYCAP_AGENT_EMPTY, KEYCAP_AGENT_EMPTY,
	};
	bool agents_active = false;
	bool status_active = true;
	keycap_gesture_init(&gestures);
	keycap_lighting_default(&lighting);
	keycap_line_reader_init(&line_reader);

	/* Console bring-up can fail after a debugger reset, before the board's
	 * serial bridge has re-enumerated. Returning here ends the main thread:
	 * the device goes permanently silent with the NeoKey holding whatever
	 * frame it last received, and only a power cycle recovers it. Retry
	 * instead, so a transient failure costs a moment rather than the session.
	 */
	while (serial_rx_start() != 0) {
		k_sleep(K_MSEC(250));
	}
	send_hello();
	while ((keycap_neokey_status =
			neokey_init(&keys, i2c, NEOKEY_ADDRESS)) != 0) {
		serial_write("ERROR neokey-init\n");
		/* Keep draining the receive ring between attempts. A blocking
		 * sleep here overflows the ring with the host's PING and
		 * KEEPALIVE traffic and desynchronizes the line protocol.
		 */
		for (uint32_t slice = 0; slice < NEOKEY_RETRY_SLICES; ++slice) {
			pump_serial(&keys, false, &lighting, agent_states,
				    &agents_active, &status_active,
				    &last_host_command, &host_timed_out);
			k_sleep(K_MSEC(NEOKEY_RETRY_SLICE_MS));
		}
	}
	serial_write("READY neokey 0x30\n");
	show_status(&keys, KEYCAP_STATUS_PAUSED, 0, NULL);
	/* Commands received while NeoKey was unavailable were deliberately
	 * acknowledged but could not be rendered. Re-announce readiness now so
	 * the host pushes the current status and lighting profile again. Without
	 * this handshake, a normal slow I2C start can leave all keys stuck on the
	 * paused/orange frame until the next unrelated UI state change.
	 */
	send_hello();

	while (true) {
		bool was_timed_out = host_timed_out;

		pump_serial(&keys, true, &lighting, agent_states, &agents_active,
			    &status_active, &last_host_command, &host_timed_out);
		if (was_timed_out && !host_timed_out) {
			/* The host is back. It only sends STATUS on a state change, so
			 * announce ourselves to make it push its current state instead of
			 * waiting for one that may never come.
			 */
			send_hello();
		}

		uint8_t sample;
		if (neokey_read_buttons(&keys, &sample) == 0) {
			if (sample != candidate) {
				candidate = sample;
				candidate_count = 1;
			} else if (candidate_count < DEBOUNCE_SAMPLES) {
				++candidate_count;
			}

			if (candidate_count == DEBOUNCE_SAMPLES && candidate != stable) {
				uint8_t changed = candidate ^ stable;
				stable = candidate;
				for (uint8_t key = 0; key < KEYCAP_LED_COUNT; ++key) {
					uint8_t bit = BIT(key);
					if ((changed & bit) != 0 &&
					    keycap_protocol_format_button(
						    event_line, sizeof(event_line), key + 1,
						    (stable & bit) != 0, ++sequence) > 0) {
						serial_write(event_line);
					}
				}
			}
		}

		uint32_t now = k_uptime_get_32();
		struct keycap_gesture_event events[KEYCAP_GESTURE_KEY_COUNT];
		size_t event_count = keycap_gesture_update(
			&gestures, stable, now, events, ARRAY_SIZE(events));
		for (size_t index = 0; index < event_count; ++index) {
			const char *name = events[index].type == KEYCAP_GESTURE_SHORT ? "SHORT" :
					   events[index].type == KEYCAP_GESTURE_LONG ? "LONG" :
					   "DOUBLE";
			if (keycap_protocol_format_gesture(event_line, sizeof(event_line),
						   events[index].key, name, ++sequence) > 0) {
				serial_write(event_line);
			}
		}

		/* The microphone is powered only while its effect is selected and the
		 * standby lane is actually visible. An approval overlay or agent
		 * status takes the keys back, and the microphone with them.
		 */
		bool audio_effect = lighting.mode == KEYCAP_LIGHTING_AUDIO ||
				    lighting.mode == KEYCAP_LIGHTING_SPECTRUM ||
				    lighting.mode == KEYCAP_LIGHTING_PITCH ||
				    lighting.mode == KEYCAP_LIGHTING_TEMPO;

		/* Touching the keypad is the wake gesture. The microphone is off
		 * while asleep, so it cannot hear its own way back.
		 */
		if (audio_asleep && stable != 0u) {
			audio_asleep = false;
		}

		bool wants_audio = audio_effect && !status_active && !agents_active &&
				   !audio_asleep;
		if (wants_audio != keycap_audio_is_running()) {
			if (wants_audio) {
				(void)keycap_audio_start();
			} else {
				keycap_audio_stop();
			}
		}
		uint32_t lighting_frame = now / KEYCAP_LIGHTING_FRAME_MS;
		if (lighting_frame != last_lighting_frame && !status_active) {
			struct keycap_rgb colors[KEYCAP_LED_COUNT];
			if (agents_active) {
				keycap_agent_render(agent_states, stable, now, colors);
			} else if (audio_effect && audio_asleep) {
				/* Nothing to visualise and no microphone running, so
				 * show a plain dim standby rather than a dark keypad.
				 */
				struct keycap_lighting_profile standby = lighting;

				standby.mode = KEYCAP_LIGHTING_RAINBOW;
				standby.brightness = lighting.brightness / 4u;
				keycap_lighting_render(&standby, stable, now, colors);
			} else if (audio_effect) {
				struct keycap_audio_frame frame;

				keycap_audio_get(&frame);
				if (frame.quiet) {
					/* Silent long enough that holding the microphone
					 * powered serves no one. Sleep until touched.
					 */
					audio_asleep = true;
				}
				if (lighting.mode == KEYCAP_LIGHTING_AUDIO) {
					keycap_audio_render(&lighting, frame.level, stable,
							    now, colors);
				} else if (lighting.mode == KEYCAP_LIGHTING_TEMPO) {
					keycap_tempo_render(&lighting, frame.level,
							    frame.beats, stable, colors);
				} else if (lighting.mode == KEYCAP_LIGHTING_PITCH) {
					keycap_pitch_render(&lighting, frame.level,
							    frame.pitch, stable, colors);
				} else {
					keycap_spectrum_render(&lighting, frame.band,
							       stable, colors);
				}
			} else {
				keycap_lighting_render(&lighting, stable, now, colors);
			}
			if (neokey_set_leds(&keys, colors) != 0) {
				keycap_neokey_status = -EIO;
			}
			last_lighting_frame = lighting_frame;
		}

		/* The fail-safe is held by host_timed_out alone. Latching
		 * status_active here would survive the host's return, because only a
		 * STATUS command clears it and the host sends those on state changes
		 * only -- leaving the keys amber on a healthy link.
		 */
		if (!host_timed_out &&
		    now - last_host_command >= HOST_WATCHDOG_MS) {
			host_timed_out = true;
			agents_active = false;
			/* Continue the last configured standalone lighting effect while
			 * asking the host to reconnect. Amber is reserved for an explicit
			 * PAUSED command; a sleeping Mac must not latch the keyboard there.
			 */
			status_active = false;
			send_hello();
			last_hello_retry = now;
		} else if (host_timed_out &&
			   now - last_hello_retry >= HOST_HELLO_RETRY_MS) {
			/* The first HELLO was emitted during the outage that tripped the
			 * watchdog, so it is the line most likely to have been lost.
			 * Keep asking until the host answers.
			 */
			send_hello();
			last_hello_retry = now;
		}
		k_sleep(K_MSEC(10));
	}
	return 0;
}
```

## src/audio.c
```c
/* SPDX-License-Identifier: Apache-2.0 */
#include "audio.h"

#include <string.h>
#include <zephyr/audio/dmic.h>
#include <zephyr/device.h>
#include <zephyr/drivers/regulator.h>
#include <zephyr/kernel.h>

#define AUDIO_SAMPLE_RATE 16000u
#define AUDIO_FRAME_SAMPLES 256u
#define AUDIO_BLOCK_BYTES (AUDIO_FRAME_SAMPLES * sizeof(int16_t))
#define AUDIO_BLOCK_COUNT 4
#define AUDIO_READ_TIMEOUT_MS 250
#define AUDIO_THREAD_STACK 2048
/* Below the console and main loop: a dropped audio frame costs one LED update,
 * a delayed serial line costs an approval.
 */
#define AUDIO_THREAD_PRIORITY 10

static const struct device *const dmic = DEVICE_DT_GET(DT_NODELABEL(dmic_dev));
static const struct device *const mic_power =
	DEVICE_DT_GET_OR_NULL(DT_NODELABEL(pdm_imu_pwr));

K_MEM_SLAB_DEFINE_STATIC(audio_slab, AUDIO_BLOCK_BYTES, AUDIO_BLOCK_COUNT, 4);
static K_THREAD_STACK_DEFINE(audio_stack, AUDIO_THREAD_STACK);
static struct k_thread audio_thread;
static k_tid_t audio_tid;

/* Two aligned words, so a reader never needs a lock: the overall level in one
 * store and the four band levels packed into another.
 */
static volatile uint32_t published_level;
static volatile uint32_t published_bands;
static volatile uint32_t published_beats;
static volatile bool stop_requested;
static volatile bool running;

/* Visible to a debugger during bring-up, like the other probe words. */
volatile int keycap_audio_status = -1;
volatile uint32_t keycap_audio_frames;

static int configure(void)
{
	static struct pcm_stream_cfg stream = {
		.pcm_width = 16,
		.pcm_rate = AUDIO_SAMPLE_RATE,
		.block_size = AUDIO_BLOCK_BYTES,
		.mem_slab = &audio_slab,
	};
	struct dmic_cfg cfg = {
		.io = {
			.min_pdm_clk_freq = 1000000,
			.max_pdm_clk_freq = 3500000,
			.min_pdm_clk_dc = 40,
			.max_pdm_clk_dc = 60,
		},
		.streams = &stream,
		.channel = {
			.req_num_streams = 1,
			.req_num_chan = 1,
			.req_chan_map_lo = dmic_build_channel_map(0, 0, PDM_CHAN_LEFT),
		},
	};

	return dmic_configure(dmic, &cfg);
}

static void audio_entry(void *a, void *b, void *c)
{
	struct keycap_audio_filters filters;
	struct keycap_audio_analyzer analyzer;

	ARG_UNUSED(a);
	ARG_UNUSED(b);
	ARG_UNUSED(c);

	keycap_audio_filters_reset(&filters);
	keycap_audio_analyzer_init(&analyzer);

	keycap_audio_status = configure();
	if (keycap_audio_status != 0) {
		running = false;
		return;
	}

	keycap_audio_status = dmic_trigger(dmic, DMIC_TRIGGER_START);
	if (keycap_audio_status != 0) {
		running = false;
		return;
	}

	while (!stop_requested) {
		void *buffer;
		uint32_t size;

		int error = dmic_read(dmic, 0, &buffer, &size, AUDIO_READ_TIMEOUT_MS);
		if (error != 0) {
			keycap_audio_status = error;
			continue;
		}

		struct keycap_audio_energy energy;
		uint32_t bands = 0;

		keycap_audio_filters_run(&filters, (const int16_t *)buffer,
					 size / sizeof(int16_t), &energy);
		keycap_audio_analyzer_update(&analyzer, &energy);
		for (uint8_t band = 0; band < KEYCAP_AUDIO_BANDS; ++band) {
			bands |= (uint32_t)keycap_audio_analyzer_band(&analyzer, band)
				 << (band * 8u);
		}
		/* Level in the low byte, pitch in the next, so both still land in
		 * one aligned store.
		 */
		published_level = keycap_audio_analyzer_level(&analyzer) |
				  ((uint32_t)keycap_audio_analyzer_pitch(&analyzer) << 8u) |
				  (keycap_audio_analyzer_is_quiet(&analyzer) ? 1u << 16u : 0u);
		published_bands = bands;
		published_beats = keycap_audio_analyzer_beats(&analyzer);
		++keycap_audio_frames;
		k_mem_slab_free(&audio_slab, buffer);
	}

	(void)dmic_trigger(dmic, DMIC_TRIGGER_STOP);
	published_level = 0;
	published_bands = 0;
	running = false;
}

int keycap_audio_start(void)
{
	if (running) {
		return 0;
	}
	if (!device_is_ready(dmic)) {
		keycap_audio_status = -ENODEV;
		return -ENODEV;
	}
	if (mic_power != NULL && device_is_ready(mic_power)) {
		int error = regulator_enable(mic_power);
		if (error != 0) {
			keycap_audio_status = error;
			return error;
		}
	}

	stop_requested = false;
	running = true;
	audio_tid = k_thread_create(&audio_thread, audio_stack,
				    K_THREAD_STACK_SIZEOF(audio_stack), audio_entry,
				    NULL, NULL, NULL, AUDIO_THREAD_PRIORITY, 0,
				    K_NO_WAIT);
	k_thread_name_set(audio_tid, "keycap_audio");
	return 0;
}

void keycap_audio_stop(void)
{
	if (!running) {
		return;
	}
	stop_requested = true;
	if (audio_tid != NULL) {
		(void)k_thread_join(&audio_thread, K_MSEC(500));
		audio_tid = NULL;
	}
	running = false;
	published_level = 0;
	published_bands = 0;
	if (mic_power != NULL && device_is_ready(mic_power)) {
		(void)regulator_disable(mic_power);
	}
}

bool keycap_audio_is_running(void)
{
	return running;
}

void keycap_audio_get(struct keycap_audio_frame *frame)
{
	uint32_t bands = published_bands;
	uint32_t level = published_level;

	frame->level = (uint8_t)(level & 0xffu);
	frame->pitch = (uint8_t)((level >> 8u) & 0xffu);
	frame->quiet = (level & (1u << 16u)) != 0u;
	frame->beats = published_beats;
	for (uint8_t band = 0; band < KEYCAP_AUDIO_BANDS; ++band) {
		frame->band[band] = (uint8_t)((bands >> (band * 8u)) & 0xffu);
	}
}
```

## src/audio.h
```c
/* SPDX-License-Identifier: Apache-2.0 */
#ifndef KEYCAP_AUDIO_H
#define KEYCAP_AUDIO_H

#include "audio_bands.h"

#include <stdbool.h>
#include <stdint.h>

struct keycap_audio_frame {
	/* Overall loudness, 0..255, spread across the keys as one bar. */
	uint8_t level;
	/* Per-band levels, 0..255, lowest band first. */
	uint8_t band[KEYCAP_AUDIO_BANDS];
	/* Colour-wheel position of the sound's current centre of gravity. */
	uint8_t pitch;
	/* Nothing has played for long enough to power the microphone down. */
	bool quiet;
	/* Bass transients counted so far, for effects that advance with the
	 * music rather than with a clock.
	 */
	uint32_t beats;
};

/* Power the microphone and begin analysis. Idempotent.
 *
 * The microphone is only powered while the audio effect is selected: the
 * regulator is switched off again on stop, so "off" means unpowered rather
 * than merely ignored.
 */
int keycap_audio_start(void);
void keycap_audio_stop(void);
bool keycap_audio_is_running(void);

/* Latest analysis. Lock-free and safe to call from any thread. */
void keycap_audio_get(struct keycap_audio_frame *frame);

#endif
```

## src/audio_bands.c
```c
/* SPDX-License-Identifier: Apache-2.0 */
#include "audio_bands.h"

#include <string.h>

#define DC_SHIFT 8
#define LOW_SHIFT 4
#define MID_SHIFT 2
#define HIGH_SHIFT 1

/* Below this span between floor and peak the signal is indistinguishable from
 * the room's own noise, so the meter stays down rather than amplifying hiss
 * into a light show.
 */
#define MINIMUM_SPAN 64u

/* Dynamic range, as a multiple of the floor, below which the room counts as
 * silent for the purpose of sleeping the microphone.
 *
 * A ratio rather than a fixed span, because the right absolute threshold
 * differs by room and by microphone gain: measured here, music holds its peak
 * around 28 times its floor while a quiet room stays within 1.6 times. The
 * additive term keeps the test meaningful when both values sit near zero.
 *
 * Note the peak cannot simply decay to the floor: a steady tone re-arms it
 * every frame, so "no sound" is a narrow range, not a vanishing one.
 */
#define QUIET_RATIO 2u

/* A beat is bass rising clear of its own recent average. The ratio is a
 * compromise: lower and a sustained bassline retriggers constantly, higher and
 * a soft kick is missed.
 */
#define BEAT_RATIO_NUM 7u
#define BEAT_RATIO_DEN 5u
#define BEAT_MINIMUM_MARGIN 64u
/* A beat must also be a rise, as a fraction of the previous frame. Being loud
 * is not the same as being a transient: a sustained bass note sits above its
 * own average for as long as it lasts and would otherwise retrigger endlessly.
 */
#define BEAT_RISE_SHIFT 2u
/* Frames a beat stays latched, which also debounces the next one. */
#define BEAT_HOLD_FRAMES 4u

/* Colour-wheel span used by the pitch effect: 0 is red, 85 green, 170 blue, so
 * stopping short of a full turn runs red -> green -> blue -> violet without
 * wrapping back to red at the treble end.
 */
#define PITCH_MAX_HUE 200u
/* Percent of the gap closed per frame. Low enough that the colour drifts rather
 * than flickering between hues on every transient.
 */
#define PITCH_SMOOTHING 6u

/* Tilt applied to each band before taking the centroid.
 *
 * Musical energy falls away with frequency, so an untilted centroid sits
 * pinned at the bass end. These weights lift the upper bands back toward
 * comparable magnitude. They are deliberately gentle: an aggressive tilt lets a
 * near-silent treble band outvote a loud kick, which keeps bass-heavy music off
 * the red end where it belongs.
 */
static const uint8_t pitch_tilt[KEYCAP_AUDIO_BANDS] = {1u, 2u, 3u, 4u};

void keycap_audio_filters_reset(struct keycap_audio_filters *filters)
{
	memset(filters, 0, sizeof(*filters));
}

static uint32_t absolute(int32_t value)
{
	return value < 0 ? (uint32_t)-value : (uint32_t)value;
}

void keycap_audio_filters_run(struct keycap_audio_filters *filters,
			      const int16_t *samples, size_t count,
			      struct keycap_audio_energy *energy)
{
	uint64_t total = 0;
	uint64_t sums[KEYCAP_AUDIO_BANDS] = {0};

	memset(energy, 0, sizeof(*energy));
	if (count == 0u) {
		return;
	}

	for (size_t index = 0; index < count; ++index) {
		int32_t sample = samples[index];

		/* PDM output carries a DC offset that would otherwise read as a
		 * constant loud signal and hold the display open on silence.
		 */
		filters->dc_accumulator += sample - (filters->dc_accumulator >> DC_SHIFT);
		sample -= filters->dc_accumulator >> DC_SHIFT;

		filters->low_accumulator += sample - (filters->low_accumulator >> LOW_SHIFT);
		filters->mid_accumulator += sample - (filters->mid_accumulator >> MID_SHIFT);
		filters->high_accumulator += sample - (filters->high_accumulator >> HIGH_SHIFT);

		int32_t low = filters->low_accumulator >> LOW_SHIFT;
		int32_t mid = filters->mid_accumulator >> MID_SHIFT;
		int32_t high = filters->high_accumulator >> HIGH_SHIFT;

		total += absolute(sample);
		sums[0] += absolute(low);
		sums[1] += absolute(mid - low);
		sums[2] += absolute(high - mid);
		sums[3] += absolute(sample - high);
	}

	energy->overall = (uint32_t)(total / count);
	for (uint8_t band = 0; band < KEYCAP_AUDIO_BANDS; ++band) {
		energy->band[band] = (uint32_t)(sums[band] / count);
	}
}

static void channel_init(struct keycap_audio_channel *channel)
{
	memset(channel, 0, sizeof(*channel));
	channel->peak = MINIMUM_SPAN;
}

static void channel_update(struct keycap_audio_channel *channel, uint32_t energy)
{
	/* The floor drops quickly onto a new minimum but creeps back up, so a
	 * quiet passage does not instantly rescale the display.
	 */
	if (energy < channel->floor) {
		channel->floor -= (channel->floor - energy) / 2u;
	} else {
		channel->floor += (energy - channel->floor) / 256u;
	}

	/* The peak jumps to a new maximum and decays back toward the floor, which
	 * is what stops a fading track from leaving the display pinned.
	 */
	if (energy > channel->peak) {
		channel->peak = energy;
	} else if (channel->peak > channel->floor) {
		channel->peak -= (channel->peak - channel->floor) / 128u;
	}

	uint8_t target = 0u;
	if (channel->peak > channel->floor + MINIMUM_SPAN && energy > channel->floor) {
		uint64_t span = channel->peak - channel->floor;
		uint64_t scaled = ((uint64_t)(energy - channel->floor) * 255u) / span;
		target = scaled > 255u ? 255u : (uint8_t)scaled;
	}

	if (target >= channel->level) {
		channel->level = target;
	} else {
		uint16_t drop =
			(uint16_t)(channel->level - target) * KEYCAP_AUDIO_RELEASE / 100u;
		channel->level = (uint8_t)(channel->level - (drop == 0u ? 1u : drop));
	}
}

void keycap_audio_analyzer_init(struct keycap_audio_analyzer *analyzer)
{
	/* Clear the whole struct, not only the channels: the analyzer lives on
	 * the audio thread's stack, so beats, pitch, the quiet countdown and the
	 * bass history would otherwise start from whatever was there before.
	 */
	memset(analyzer, 0, sizeof(*analyzer));
	channel_init(&analyzer->overall);
	for (uint8_t band = 0; band < KEYCAP_AUDIO_BANDS; ++band) {
		channel_init(&analyzer->band[band]);
	}
}

void keycap_audio_analyzer_update(struct keycap_audio_analyzer *analyzer,
				  const struct keycap_audio_energy *energy)
{
	uint64_t weighted = 0;
	uint64_t total = 0;

	channel_update(&analyzer->overall, energy->overall);
	if (analyzer->overall.peak >
	    analyzer->overall.floor * QUIET_RATIO + MINIMUM_SPAN) {
		analyzer->quiet_frames = 0u;
	} else if (analyzer->quiet_frames < KEYCAP_AUDIO_SLEEP_FRAMES) {
		++analyzer->quiet_frames;
	}

	for (uint8_t band = 0; band < KEYCAP_AUDIO_BANDS; ++band) {
		channel_update(&analyzer->band[band], energy->band[band]);

		/* The centroid reads raw energy, not the normalised level. Each
		 * band's auto-gain drives it to full whenever it is near its own
		 * recent maximum, so normalised levels sit at 255 together and
		 * carry no balance between bands to take a centroid of.
		 *
		 * Only energy *above* the band's own noise floor votes. The tilt
		 * multiplies the top band eightfold, so without this the room's
		 * hiss alone is enough to drag bass-heavy music away from red.
		 */
		uint32_t floor = analyzer->band[band].floor;
		uint32_t excess = energy->band[band] > floor
					  ? energy->band[band] - floor
					  : 0u;
		uint64_t tilted = (uint64_t)excess * pitch_tilt[band];

		/* Squared, so the loudest band wins decisively instead of being
		 * averaged against three quieter ones. A plain mean drifts to the
		 * middle of the wheel and every kind of music comes out green.
		 */
		uint64_t sharpened = tilted * tilted;

		weighted += sharpened * band;
		total += sharpened;
	}

	uint32_t bass = energy->band[0];
	uint32_t previous = analyzer->bass_previous;
	bool clear_of_noise = bass > analyzer->band[0].floor + BEAT_MINIMUM_MARGIN;
	bool above_average = (uint64_t)bass * BEAT_RATIO_DEN >
			     (uint64_t)analyzer->bass_average * BEAT_RATIO_NUM;
	/* Requiring previous > 0 also suppresses a spurious beat on the very
	 * first frame, when there is no history to rise from.
	 */
	bool rising = previous > 0u && bass > previous + (previous >> BEAT_RISE_SHIFT);

	if (analyzer->beat_hold > 0u) {
		--analyzer->beat_hold;
	} else if (clear_of_noise && above_average && rising) {
		analyzer->beat_hold = BEAT_HOLD_FRAMES;
		++analyzer->beats;
	}
	analyzer->bass_previous = bass;
	analyzer->bass_average +=
		((int32_t)bass - (int32_t)analyzer->bass_average) / 8;

	if (total > 0u) {
		uint32_t target = (uint32_t)((weighted * PITCH_MAX_HUE) /
					     (total * (KEYCAP_AUDIO_BANDS - 1u)));
		analyzer->pitch = (uint16_t)((int32_t)analyzer->pitch +
					     ((int32_t)target - (int32_t)analyzer->pitch) *
						     (int32_t)PITCH_SMOOTHING / 100);
	}
}

uint8_t keycap_audio_analyzer_level(const struct keycap_audio_analyzer *analyzer)
{
	return analyzer->overall.level;
}

uint8_t keycap_audio_analyzer_band(const struct keycap_audio_analyzer *analyzer,
				   uint8_t band)
{
	return band < KEYCAP_AUDIO_BANDS ? analyzer->band[band].level : 0u;
}

uint8_t keycap_audio_analyzer_pitch(const struct keycap_audio_analyzer *analyzer)
{
	return analyzer->pitch > 255u ? 255u : (uint8_t)analyzer->pitch;
}

bool keycap_audio_analyzer_is_quiet(const struct keycap_audio_analyzer *analyzer)
{
	return analyzer->quiet_frames >= KEYCAP_AUDIO_SLEEP_FRAMES;
}

uint32_t keycap_audio_analyzer_beats(const struct keycap_audio_analyzer *analyzer)
{
	return analyzer->beats;
}

uint8_t keycap_audio_key_fill(uint8_t level, uint8_t key)
{
	if (key >= KEYCAP_LED_COUNT) {
		return 0u;
	}

	/* Stretch 0..255 across the four keys, then take this key's slice: the
	 * bar is continuous, so key n starts only once key n-1 is full.
	 */
	uint32_t stretched = (uint32_t)level * KEYCAP_LED_COUNT;
	uint32_t start = (uint32_t)key * 255u;

	if (stretched <= start) {
		return 0u;
	}
	uint32_t fill = stretched - start;
	return fill > 255u ? 255u : (uint8_t)fill;
}
```

## src/audio_bands.h
```c
/* SPDX-License-Identifier: Apache-2.0 */
#ifndef KEYCAP_AUDIO_BANDS_H
#define KEYCAP_AUDIO_BANDS_H

#include "protocol.h"

#include <stdbool.h>
#include <stddef.h>
#include <stdint.h>

#define KEYCAP_AUDIO_BANDS KEYCAP_LED_COUNT

/* How far a level falls per frame, as a percentage of the gap to the new
 * value. Rise is always immediate. Fixed rather than user-configurable because
 * Speed drives the colour cycle; this is tuned to read like a VU needle.
 */
#define KEYCAP_AUDIO_RELEASE 18u

/* Level held on an otherwise dark key so the device never looks faulty. */
#define KEYCAP_AUDIO_EMBER 16u

/* Beats per full turn of the colour wheel for the tempo effect. Two bars of
 * four, so the colour returns to where it started on a musical boundary.
 */
#define KEYCAP_TEMPO_BEATS_PER_CYCLE 8u

/* Frames of silence before the microphone is put to sleep. Frames arrive every
 * 16 ms, so this is about ten minutes.
 *
 * A selected effect otherwise holds the microphone powered all day whether or
 * not anything is playing. Sleeping on silence means it is live when there is
 * music, not merely when the effect is chosen.
 */
#define KEYCAP_AUDIO_SLEEP_FRAMES 37500u

/* A DC blocker and a bank of one-pole low-pass filters.
 *
 * A 256-point FFT was the obvious choice for the spectrum, but four LEDs cannot
 * show more than four buckets and cascaded one-poles reach the same visible
 * result without pulling CMSIS-DSP into the build. The shift amounts put the
 * corners near 170 Hz, 700 Hz and 1.8 kHz at 16 kHz: bass, low mid, presence
 * and air.
 *
 * Each filter keeps a scaled accumulator on purpose: a plain
 * y += (x - y) >> shift stalls once the difference falls below the shift and
 * leaves a residue large enough to hold a key lit on silence.
 */
struct keycap_audio_filters {
	int32_t dc_accumulator;
	int32_t low_accumulator;
	int32_t mid_accumulator;
	int32_t high_accumulator;
};

struct keycap_audio_energy {
	/* Mean absolute amplitude across the whole frame. */
	uint32_t overall;
	/* Mean absolute amplitude per band, lowest first. */
	uint32_t band[KEYCAP_AUDIO_BANDS];
};

void keycap_audio_filters_reset(struct keycap_audio_filters *filters);

/* Measure one frame. Both effects are fed from this single pass. */
void keycap_audio_filters_run(struct keycap_audio_filters *filters,
			      const int16_t *samples, size_t count,
			      struct keycap_audio_energy *energy);

/* One normalised channel: its own noise floor, its own peak, its own level.
 *
 * A fixed scale is the usual mistake: it reads as dead in a quiet room and
 * pinned at full next to a speaker. Tracking floor and peak per channel means
 * the display uses its whole range at any volume.
 */
struct keycap_audio_channel {
	uint32_t floor;
	uint32_t peak;
	uint8_t level;
};

struct keycap_audio_analyzer {
	struct keycap_audio_channel overall;
	struct keycap_audio_channel band[KEYCAP_AUDIO_BANDS];
	uint16_t pitch;
	uint32_t quiet_frames;
	uint32_t bass_average;
	uint32_t bass_previous;
	uint32_t beats;
	uint8_t beat_hold;
};

void keycap_audio_analyzer_init(struct keycap_audio_analyzer *analyzer);
void keycap_audio_analyzer_update(struct keycap_audio_analyzer *analyzer,
				  const struct keycap_audio_energy *energy);

/* Overall loudness, 0..255, for the level meter. */
uint8_t keycap_audio_analyzer_level(const struct keycap_audio_analyzer *analyzer);
/* One band's level, 0..255, for the spectrum. */
uint8_t keycap_audio_analyzer_band(const struct keycap_audio_analyzer *analyzer,
				   uint8_t band);

/* Where the sound currently sits in the spectrum, as a colour-wheel position
 * from red through green to violet.
 *
 * This is a centroid over raw band energy with a fixed tilt, not over the
 * normalised levels. Per-band auto-gain drives every band to full whenever it
 * sits near its own recent maximum, so the normalised levels reach 255 together
 * and preserve no balance to take a centroid of. The tilt compensates for the
 * steep falloff of musical energy with frequency, which would otherwise pin the
 * result at the bass end. A bass drop pulls it red, a cymbal crash pushes it
 * violet.
 *
 * Contributions are squared before the centroid is taken, so the loudest band
 * wins decisively. A plain mean over four bands drifts to the middle of the
 * wheel and every kind of music comes out green.
 *
 * Silence holds the last position rather than snapping back to red.
 */
uint8_t keycap_audio_analyzer_pitch(const struct keycap_audio_analyzer *analyzer);

/* Whether nothing has been playing for long enough to sleep the microphone.
 *
 * Silence is judged by how little dynamic range the overall channel has, as a
 * ratio rather than an absolute level: every room has its own noise, and a
 * fixed threshold would either never fire in one room or fire constantly in
 * another. Music keeps its peak many times its floor; a room's own noise stays
 * within a factor of two of it.
 */
bool keycap_audio_analyzer_is_quiet(const struct keycap_audio_analyzer *analyzer);

/* How many bass transients have been counted since the effect started.
 *
 * Measured on raw bass energy against its own rolling average, not on the
 * normalised level: per-band auto-gain pins a steady loud passage at full
 * scale, leaving a kick no headroom to stand out in. A transient is a property
 * of the signal, not of the display mapping.
 *
 * The count is what lets a colour advance with the music instead of with a
 * clock, so a slow track drifts and a fast one races.
 */
uint32_t keycap_audio_analyzer_beats(const struct keycap_audio_analyzer *analyzer);

/* How brightly one key burns for a given meter level, 0..255.
 *
 * The four keys are a single bar: each fills completely before the next begins,
 * and a key already full stays full. Louder lights more keys, never different
 * ones.
 */
uint8_t keycap_audio_key_fill(uint8_t level, uint8_t key);

#endif
```

## src/gesture.c
```c
/* SPDX-License-Identifier: Apache-2.0 */
#include "gesture.h"

#include <string.h>

static void emit(struct keycap_gesture_event *events, size_t capacity,
		 size_t *count, uint8_t key, enum keycap_gesture_type type)
{
	if (*count < capacity) {
		events[*count] = (struct keycap_gesture_event){.key = key, .type = type};
	}
	++(*count);
}

void keycap_gesture_init(struct keycap_gesture_detector *detector)
{
	memset(detector, 0, sizeof(*detector));
}

size_t keycap_gesture_update(struct keycap_gesture_detector *detector,
			     uint8_t pressed_mask, uint32_t now_ms,
			     struct keycap_gesture_event *events,
			     size_t event_capacity)
{
	size_t event_count = 0;

	for (uint8_t index = 0; index < KEYCAP_GESTURE_KEY_COUNT; ++index) {
		struct keycap_gesture_key_state *state = &detector->keys[index];
		bool down = (pressed_mask & (1u << index)) != 0;

		if (state->pending_short && !state->down &&
		    now_ms - state->released_at >= KEYCAP_DOUBLE_PRESS_MS) {
			state->pending_short = false;
			emit(events, event_capacity, &event_count, index + 1,
			     KEYCAP_GESTURE_SHORT);
		}

		if (down && !state->down) {
			state->down = true;
			state->down_at = now_ms;
			state->long_emitted = false;
			state->second_press = state->pending_short &&
				(now_ms - state->released_at < KEYCAP_DOUBLE_PRESS_MS);
			if (state->second_press) {
				state->pending_short = false;
			}
		} else if (!down && state->down) {
			state->down = false;
			if (state->long_emitted) {
				state->second_press = false;
			} else if (state->second_press) {
				state->second_press = false;
				emit(events, event_capacity, &event_count, index + 1,
				     KEYCAP_GESTURE_DOUBLE);
			} else if (now_ms - state->down_at >= KEYCAP_LONG_PRESS_MS) {
				emit(events, event_capacity, &event_count, index + 1,
				     KEYCAP_GESTURE_LONG);
			} else {
				state->pending_short = true;
				state->released_at = now_ms;
			}
		} else if (down && !state->long_emitted && !state->second_press &&
			   now_ms - state->down_at >= KEYCAP_LONG_PRESS_MS) {
			state->long_emitted = true;
			state->pending_short = false;
			emit(events, event_capacity, &event_count, index + 1,
			     KEYCAP_GESTURE_LONG);
		}
	}

	return event_count > event_capacity ? event_capacity : event_count;
}
```

## src/gesture.h
```c
/* SPDX-License-Identifier: Apache-2.0 */
#ifndef KEYCAP_GESTURE_H
#define KEYCAP_GESTURE_H

#include <stdbool.h>
#include <stddef.h>
#include <stdint.h>

#define KEYCAP_GESTURE_KEY_COUNT 4
#define KEYCAP_LONG_PRESS_MS 600u
#define KEYCAP_DOUBLE_PRESS_MS 280u

enum keycap_gesture_type {
	KEYCAP_GESTURE_SHORT,
	KEYCAP_GESTURE_LONG,
	KEYCAP_GESTURE_DOUBLE,
};

struct keycap_gesture_event {
	uint8_t key;
	enum keycap_gesture_type type;
};

struct keycap_gesture_key_state {
	bool down;
	bool long_emitted;
	bool second_press;
	bool pending_short;
	uint32_t down_at;
	uint32_t released_at;
};

struct keycap_gesture_detector {
	struct keycap_gesture_key_state keys[KEYCAP_GESTURE_KEY_COUNT];
};

void keycap_gesture_init(struct keycap_gesture_detector *detector);
size_t keycap_gesture_update(struct keycap_gesture_detector *detector,
			     uint8_t pressed_mask, uint32_t now_ms,
			     struct keycap_gesture_event *events,
			     size_t event_capacity);

#endif
```

## src/lighting.c
```c
/* SPDX-License-Identifier: Apache-2.0 */
#include "lighting.h"
#include "audio_bands.h"

#include <string.h>

static const struct keycap_rgb default_colors[KEYCAP_LED_COUNT] = {
	{.red = 0, .green = 255, .blue = 32},
	{.red = 0, .green = 112, .blue = 255},
	{.red = 220, .green = 0, .blue = 255},
	{.red = 255, .green = 72, .blue = 0},
};

static struct keycap_rgb scale_color(struct keycap_rgb color, uint8_t amount)
{
	return (struct keycap_rgb){
		.red = (uint8_t)((uint16_t)color.red * amount / 100u),
		.green = (uint8_t)((uint16_t)color.green * amount / 100u),
		.blue = (uint8_t)((uint16_t)color.blue * amount / 100u),
	};
}

void keycap_lighting_default(struct keycap_lighting_profile *profile)
{
	*profile = (struct keycap_lighting_profile){
		.mode = KEYCAP_LIGHTING_RAINBOW,
		.brightness = 70,
		.speed = 50,
	};
	memcpy(profile->key_colors, default_colors, sizeof(default_colors));
}

static struct keycap_rgb color_wheel(uint8_t position)
{
	if (position < 85u) {
		return (struct keycap_rgb){
			.red = (uint8_t)(255u - position * 3u),
			.green = (uint8_t)(position * 3u),
			.blue = 0,
		};
	}
	if (position < 170u) {
		position = (uint8_t)(position - 85u);
		return (struct keycap_rgb){
			.red = 0,
			.green = (uint8_t)(255u - position * 3u),
			.blue = (uint8_t)(position * 3u),
		};
	}

	position = (uint8_t)(position - 170u);
	return (struct keycap_rgb){
		.red = (uint8_t)(position * 3u),
		.green = 0,
		.blue = (uint8_t)(255u - position * 3u),
	};
}

void keycap_lighting_render(const struct keycap_lighting_profile *profile,
			    uint8_t pressed_mask, uint32_t uptime_ms,
			    struct keycap_rgb colors[KEYCAP_LED_COUNT])
{
	memset(colors, 0, sizeof(struct keycap_rgb) * KEYCAP_LED_COUNT);
	if (profile->mode == KEYCAP_LIGHTING_OFF || profile->brightness == 0u) {
		return;
	}
	if (pressed_mask != 0u) {
		for (uint8_t index = 0; index < KEYCAP_LED_COUNT; ++index) {
			if ((pressed_mask & (1u << index)) != 0u) {
				colors[index] = scale_color(profile->key_colors[index],
							  profile->brightness);
			}
		}
		return;
	}

	uint8_t phase = (uint8_t)(((uint64_t)uptime_ms * profile->speed) / 1200u);
	for (uint8_t index = 0; index < KEYCAP_LED_COUNT; ++index) {
		struct keycap_rgb color;
		uint8_t intensity = profile->brightness;
		switch (profile->mode) {
		case KEYCAP_LIGHTING_RAINBOW:
			color = color_wheel((uint8_t)(phase + index * 64u));
			break;
		case KEYCAP_LIGHTING_WAVE: {
			color = profile->key_colors[index];
			uint8_t wave = (uint8_t)(phase * 4u + index * 64u);
			uint8_t triangle = wave < 128u ? wave : (uint8_t)(255u - wave);
			intensity = (uint8_t)((uint16_t)profile->brightness *
					      (25u + (uint16_t)triangle * 75u / 127u) / 100u);
			break;
		}
		case KEYCAP_LIGHTING_BREATHING: {
			color = profile->key_colors[index];
			uint8_t wave = (uint8_t)(phase * 2u);
			uint8_t triangle = wave < 128u ? wave : (uint8_t)(255u - wave);
			intensity = (uint8_t)((uint16_t)profile->brightness *
					      (10u + (uint16_t)triangle * 90u / 127u) / 100u);
			break;
		}
		case KEYCAP_LIGHTING_REACTIVE:
			color = profile->key_colors[index];
			intensity = (uint8_t)(profile->brightness / 10u);
			break;
		case KEYCAP_LIGHTING_STATIC:
			color = profile->key_colors[index];
			break;
		case KEYCAP_LIGHTING_OFF:
		case KEYCAP_LIGHTING_AUDIO:
		case KEYCAP_LIGHTING_SPECTRUM:
		case KEYCAP_LIGHTING_PITCH:
		case KEYCAP_LIGHTING_TEMPO:
			/* Audio is rendered by keycap_audio_render, which needs the
			 * band levels this entry point does not carry.
			 */
			color = (struct keycap_rgb){0};
			break;
		}
		colors[index] = scale_color(color, intensity);
	}
}

void keycap_agent_render(const enum keycap_agent_state states[KEYCAP_LED_COUNT],
			 uint8_t pressed_mask, uint32_t uptime_ms,
			 struct keycap_rgb colors[KEYCAP_LED_COUNT])
{
	uint8_t wave = (uint8_t)(uptime_ms / 8u);
	uint8_t triangle = wave < 128u ? wave : (uint8_t)(255u - wave);
	uint8_t pulse = (uint8_t)(35u + (uint16_t)triangle * 65u / 127u);

	for (uint8_t index = 0; index < KEYCAP_LED_COUNT; ++index) {
		struct keycap_rgb color = {0};
		uint8_t intensity = 100u;
		switch (states[index]) {
		case KEYCAP_AGENT_EMPTY:
			break;
		case KEYCAP_AGENT_IDLE:
			color = (struct keycap_rgb){.red = 0, .green = 28, .blue = 80};
			break;
		case KEYCAP_AGENT_WORKING:
			color = (struct keycap_rgb){.red = 0, .green = 112, .blue = 255};
			intensity = pulse;
			break;
		case KEYCAP_AGENT_WAITING:
			color = (struct keycap_rgb){.red = 255, .green = 128, .blue = 0};
			intensity = pulse;
			break;
		case KEYCAP_AGENT_DONE:
			color = (struct keycap_rgb){.red = 0, .green = 255, .blue = 40};
			break;
		case KEYCAP_AGENT_ERROR:
			color = (struct keycap_rgb){.red = 255, .green = 0, .blue = 0};
			intensity = pulse;
			break;
		case KEYCAP_AGENT_RISK:
			color = (struct keycap_rgb){.red = 255, .green = 0, .blue = 96};
			intensity = pulse;
			break;
		}
		if ((pressed_mask & (1u << index)) != 0u) {
			intensity = 100u;
		}
		colors[index] = scale_color(color, intensity);
	}
}

void keycap_audio_render(const struct keycap_lighting_profile *profile,
			 uint8_t level, uint8_t pressed_mask, uint32_t uptime_ms,
			 struct keycap_rgb colors[KEYCAP_LED_COUNT])
{
	/* One hue for the whole bar, cycling at the same rate the plain rainbow
	 * effect uses, so the Speed slider means the same thing in both.
	 */
	uint8_t phase = (uint8_t)(((uint64_t)uptime_ms * profile->speed) / 1200u);
	struct keycap_rgb hue = color_wheel(phase);

	memset(colors, 0, sizeof(struct keycap_rgb) * KEYCAP_LED_COUNT);
	if (profile->brightness == 0u) {
		return;
	}

	for (uint8_t index = 0; index < KEYCAP_LED_COUNT; ++index) {
		uint16_t fill = keycap_audio_key_fill(level, index);

		if (index == 0u && fill < KEYCAP_AUDIO_EMBER) {
			/* Silence still shows a low ember on the first key rather
			 * than going dark, which would read as a fault.
			 */
			fill = KEYCAP_AUDIO_EMBER;
		}
		if ((pressed_mask & (1u << index)) != 0u) {
			fill = 255u;
		}

		uint8_t intensity = (uint8_t)((uint16_t)profile->brightness * fill / 255u);
		colors[index] = scale_color(hue, intensity);
	}
}

void keycap_spectrum_render(const struct keycap_lighting_profile *profile,
			    const uint8_t levels[KEYCAP_LED_COUNT], uint8_t pressed_mask,
			    struct keycap_rgb colors[KEYCAP_LED_COUNT])
{
	memset(colors, 0, sizeof(struct keycap_rgb) * KEYCAP_LED_COUNT);
	if (profile->brightness == 0u) {
		return;
	}

	for (uint8_t index = 0; index < KEYCAP_LED_COUNT; ++index) {
		uint16_t fill = levels[index];

		if (fill < KEYCAP_AUDIO_EMBER) {
			/* Keep a dim ember so an idle band still shows its colour
			 * rather than reading as a dead key.
			 */
			fill = KEYCAP_AUDIO_EMBER;
		}
		if ((pressed_mask & (1u << index)) != 0u) {
			fill = 255u;
		}

		uint8_t intensity = (uint8_t)((uint16_t)profile->brightness * fill / 255u);
		colors[index] = scale_color(profile->key_colors[index], intensity);
	}
}

void keycap_pitch_render(const struct keycap_lighting_profile *profile,
			 uint8_t level, uint8_t pitch, uint8_t pressed_mask,
			 struct keycap_rgb colors[KEYCAP_LED_COUNT])
{
	struct keycap_rgb hue = color_wheel(pitch);
	uint16_t fill = level < KEYCAP_AUDIO_EMBER ? KEYCAP_AUDIO_EMBER : level;

	memset(colors, 0, sizeof(struct keycap_rgb) * KEYCAP_LED_COUNT);
	if (profile->brightness == 0u) {
		return;
	}

	for (uint8_t index = 0; index < KEYCAP_LED_COUNT; ++index) {
		uint16_t key_fill = (pressed_mask & (1u << index)) != 0u ? 255u : fill;
		uint8_t intensity =
			(uint8_t)((uint16_t)profile->brightness * key_fill / 255u);

		colors[index] = scale_color(hue, intensity);
	}
}

void keycap_tempo_render(const struct keycap_lighting_profile *profile,
			 uint8_t level, uint32_t beats, uint8_t pressed_mask,
			 struct keycap_rgb colors[KEYCAP_LED_COUNT])
{
	/* A full turn of the wheel every KEYCAP_TEMPO_BEATS_PER_CYCLE beats, so
	 * the colour lands somewhere recognisable on the bar rather than
	 * wandering.
	 */
	uint8_t hue = (uint8_t)((beats % KEYCAP_TEMPO_BEATS_PER_CYCLE) * 256u /
				KEYCAP_TEMPO_BEATS_PER_CYCLE);
	struct keycap_rgb color = color_wheel(hue);

	memset(colors, 0, sizeof(struct keycap_rgb) * KEYCAP_LED_COUNT);
	if (profile->brightness == 0u) {
		return;
	}

	for (uint8_t index = 0; index < KEYCAP_LED_COUNT; ++index) {
		uint16_t fill = keycap_audio_key_fill(level, index);

		if (index == 0u && fill < KEYCAP_AUDIO_EMBER) {
			fill = KEYCAP_AUDIO_EMBER;
		}
		if ((pressed_mask & (1u << index)) != 0u) {
			fill = 255u;
		}

		uint8_t intensity = (uint8_t)((uint16_t)profile->brightness * fill / 255u);
		colors[index] = scale_color(color, intensity);
	}
}
```

## src/line_reader.c
```c
/* SPDX-License-Identifier: Apache-2.0 */
#include "line_reader.h"

#include <string.h>

void keycap_line_reader_init(struct keycap_line_reader *reader)
{
	memset(reader, 0, sizeof(*reader));
}

void keycap_line_reader_resynchronize(struct keycap_line_reader *reader)
{
	reader->length = 0;
	reader->resynchronizing = true;
}

enum keycap_line_status keycap_line_reader_push(struct keycap_line_reader *reader,
						uint8_t byte)
{
	if (byte == '\n') {
		if (reader->resynchronizing) {
			reader->resynchronizing = false;
			reader->length = 0;
			return KEYCAP_LINE_NONE;
		}
		if (reader->length == 0) {
			return KEYCAP_LINE_NONE;
		}
		reader->line[reader->length] = '\0';
		reader->length = 0;
		return KEYCAP_LINE_READY;
	}

	if (reader->resynchronizing || byte == '\r') {
		return KEYCAP_LINE_NONE;
	}

	if (reader->length + 1 < sizeof(reader->line)) {
		reader->line[reader->length++] = (char)byte;
		return KEYCAP_LINE_NONE;
	}

	keycap_line_reader_resynchronize(reader);
	return KEYCAP_LINE_OVERFLOW;
}
```
